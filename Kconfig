## Kconfig
```kconfig
mainmenu "Zilch OS configuration"

choice BUILD_PROFILE
	prompt "Build profile"
	default BUILD_DEBUG

config BUILD_DEBUG
	bool "Debug"

config BUILD_RELEASE
	bool "Release"

endchoice

config DEBUG
	bool
	default y if BUILD_DEBUG

config RELEASE
	bool
	default y if BUILD_RELEASE

config TESTS
	bool "Build tests"
	default y if BUILD_DEBUG
	depends on BUILD_DEBUG

config SELFTEST
	bool
	default y if TESTS

config HYPERVISOR_SELFTEST
	bool
	default y if SELFTEST

config VERBOSE_DIAGNOSTICS
	bool "Verbose diagnostics"
	default y if BUILD_DEBUG
	depends on BUILD_DEBUG

config TRACE
	bool "Retained runtime trace"
	default y if BUILD_DEBUG
	depends on BUILD_DEBUG

config DEBUG_INFO
	bool
	default y if BUILD_DEBUG

config PRINTK_TIME
	bool "Timestamp formatted kernel records"
	default y

source "src/kernel/Kconfig"
source "src/user/Kconfig"
source "samples/guests/Kconfig"
```

## configs/debug_defconfig
```kconfig
CONFIG_BUILD_DEBUG=y
CONFIG_TESTS=y
CONFIG_VERBOSE_DIAGNOSTICS=y
CONFIG_TRACE=y
CONFIG_GUEST_EMBEDDED_IMAGE=y
CONFIG_PRINTK_TIME=y
```

## samples/guests/Kconfig
```kconfig
menu "Guest samples"

config GUEST_ZEPHYR
	bool "Zephyr guest sample"
	default n
	depends on GUEST_EXTERNAL && GUEST_INTERACTIVE

config GUEST_LINUX
	bool "Linux guest sample"
	default n
	depends on GUEST_EXTERNAL

config GUEST_FREEBSD
	bool "FreeBSD guest sample"
	default n
	depends on GUEST_EXTERNAL

endmenu
```

## samples/guests/zephyr/debug_defconfig
```kconfig
CONFIG_BUILD_DEBUG=y
CONFIG_TESTS=y
CONFIG_VERBOSE_DIAGNOSTICS=y
CONFIG_TRACE=y
CONFIG_GUEST_EXTERNAL=y
CONFIG_GUEST_EMBEDDED_IMAGE=y
CONFIG_GUEST_INTERACTIVE=y
CONFIG_GUEST_ZEPHYR=y
CONFIG_PRINTK_TIME=y
```

## samples/guests/zephyr/release_defconfig
```kconfig
CONFIG_BUILD_RELEASE=y
CONFIG_GUEST_EXTERNAL=y
CONFIG_GUEST_EMBEDDED_IMAGE=y
CONFIG_GUEST_INTERACTIVE=y
CONFIG_GUEST_ZEPHYR=y
CONFIG_PRINTK_TIME=y
```

## src/kernel/Kconfig
```kconfig
menu "Kernel features"

config KERNEL_DEBUG_LOCKS
	bool "Extra lock diagnostics"
	default y if DEBUG
	depends on DEBUG

endmenu
```

## src/user/Kconfig
```kconfig
menu "Userspace features"

config FAULT_INJECTION
	bool "Deliberate fault injection for restart verification"
	default n
	help
	  Adds a control-plane operation that makes a role crash on demand, so
	  restart-on-fault can be verified end to end in a profile that runs
	  root_graph.hh's supervise(). Off by default: this ships a way to
	  crash a service, which production has no reason to carry. Enabled by
	  configs/guest_defconfig, which tools/verification/smoke.sh uses.

config GUEST_SUPPORT
	bool "Guest domain support"
	default y

config GUEST_TEST_ARM64
	bool "Built-in ARM64 verification guest"
	default y if SELFTEST
	depends on SELFTEST && GUEST_SUPPORT

config GUEST_VPL011_ARM64
	bool "Built-in ARM64 vPL011 guest"
	default n
	depends on GUEST_SUPPORT
	help
	  A minimal guest that drives the domain manager's virtual PL011 by
	  ordinary MMIO, with no hypercalls. Unlike GUEST_TEST_ARM64 it needs
	  no certification harness, so it does NOT depend on SELFTEST -- which
	  is what makes it runnable in a profile where init reaches
	  root_graph.hh's supervise() and actually hosts a guest.

config GUEST_EXTERNAL
	bool "External guest image support"
	default y if GUEST_SUPPORT
	depends on GUEST_SUPPORT

config GUEST_EMBEDDED_IMAGE
	bool "Embed an external guest image"
	default y if GUEST_TEST_ARM64
	depends on GUEST_EXTERNAL

config GUEST_INTERACTIVE
	bool "Interactive guest service"
	default n
	depends on GUEST_EXTERNAL

endmenu
```
