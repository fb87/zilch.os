## CMakeLists.txt
```
cmake_minimum_required(VERSION 3.20.0)
find_package(Zephyr REQUIRED HINTS $ENV{ZEPHYR_BASE})
project(zilch_zephyr_guest)

target_sources(app PRIVATE src/main.c)
```

## prj.conf
```kconfig
CONFIG_CACHE_MANAGEMENT=n
CONFIG_ARMV8_A_NS=y
CONFIG_ARM_ARCH_TIMER=y
CONFIG_MULTITHREADING=y
CONFIG_MAIN_STACK_SIZE=1024
CONFIG_ISR_STACK_SIZE=512
CONFIG_IDLE_STACK_SIZE=256
CONFIG_SERIAL=y
CONFIG_UART_PL011=y
CONFIG_UART_INTERRUPT_DRIVEN=n
CONFIG_UART_USE_RUNTIME_CONFIGURE=n
CONFIG_CONSOLE=y
CONFIG_UART_CONSOLE=y
CONFIG_SHELL=y
CONFIG_SHELL_BACKEND_SERIAL=y
CONFIG_SHELL_BACKEND_SERIAL_INTERRUPT_DRIVEN=n
CONFIG_SHELL_BACKEND_SERIAL_API_POLLING=y
CONFIG_SHELL_BACKEND_SERIAL_RX_POLL_PERIOD=10
CONFIG_SHELL_PROMPT_UART="zilch:~$ "
CONFIG_PRINTK=y
CONFIG_BOOT_BANNER=n
CONFIG_LOG=n
CONFIG_ASSERT=n
CONFIG_INIT_STACKS=n
CONFIG_FPU=n
CONFIG_FPU_SHARING=n
CONFIG_SYS_CLOCK_HW_CYCLES_PER_SEC=24000000
```

## src/irq.c
```c
#include <zephyr/arch/cpu.h>

void z_soc_irq_init(void)
{
}

void z_soc_irq_enable(unsigned int irq)
{
    (void)irq;
}

void z_soc_irq_disable(unsigned int irq)
{
    (void)irq;
}

int z_soc_irq_is_enabled(unsigned int irq)
{
    (void)irq;
    return 0;
}

void z_soc_irq_priority_set(unsigned int irq, unsigned int priority, unsigned int flags)
{
    (void)irq;
    (void)priority;
    (void)flags;
}

unsigned int z_soc_irq_get_active(void)
{
    return 1023U;
}

void z_soc_irq_eoi(unsigned int irq)
{
    (void)irq;
}
```
