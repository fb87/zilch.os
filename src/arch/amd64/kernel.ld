OUTPUT_FORMAT(elf64-x86-64)
OUTPUT_ARCH(i386:x86-64)
ENTRY(_start)
SECTIONS { . = 0x00100000; .multiboot : { KEEP(*(.multiboot)) } .text : ALIGN(4096) { KEEP(*(.text.boot)) *(.text .text.*) } .rodata : ALIGN(4096) { *(.rodata .rodata.*) /* generic driver-section registry: must match SYS_DRIVER_SECTION_NAME/SYS_OPS_SECTION_NAME/SYS_DRIVER_TABLE_BEGIN/SYS_DRIVER_TABLE_END in src/kernel/include/sys/kernel/init/init.hh and src/arch/arm64/kernel.ld -- not preprocessed, so a rename must be applied here by hand */ __sys_drivers_start = .; KEEP(*(.sys_driver)) __sys_drivers_end = .; KEEP(*(.sys_ops)) } .data : ALIGN(4096) { *(.data .data.*) } .bss (NOLOAD) : ALIGN(4096) { __bss_start = .; *(.bss .bss.* COMMON) __bss_end = .; } .stack (NOLOAD) : ALIGN(16) { . += 0x10000; __boot_stack_top = .; } __kernel_end = ALIGN(4096); /DISCARD/ : { *(.comment) *(.note*) *(.eh_frame*) *(.init_array*) *(.fini_array*) } }
